## package/apk-tools/Config.in
```kconfig
config BR2_PACKAGE_APK_TOOLS
	bool "apk-tools"
	depends on !BR2_STATIC_LIBS # unconditionally shared
	depends on BR2_TOOLCHAIN_GCC_AT_LEAST_5 # compound literals
	depends on BR2_USE_MMU # fork()
	select BR2_PACKAGE_OPENSSL
	select BR2_PACKAGE_ZLIB
	help
	  Alpine Package Keeper (apk) is a package manager developed for
	  Alpine Linux.

	  https://gitlab.alpinelinux.org/alpine/apk-tools
```

## package/micromamba/Config.in
```kconfig
config BR2_PACKAGE_MICROMAMBA_ARCH_SUPPORTS
	bool
	# See libmamba/include/mamba/core/context.hpp
	default y if BR2_arm && (BR2_ARM_CPU_ARMV6 || BR2_ARM_CPU_ARMV7A)
	default y if BR2_aarch64
	default y if BR2_i386
	default y if BR2_powerpc64
	default y if BR2_powerpc64le
	default y if BR2_s390x
	default y if BR2_x86_64
	depends on BR2_USE_MMU # fork()

config BR2_PACKAGE_MICROMAMBA
	bool "micromamba"
	depends on BR2_PACKAGE_MICROMAMBA_ARCH_SUPPORTS
	depends on BR2_USE_WCHAR # fmt, reproc
	depends on BR2_INSTALL_LIBSTDCPP
	depends on BR2_TOOLCHAIN_HAS_THREADS # pthread
	depends on BR2_TOOLCHAIN_GCC_AT_LEAST_8 # C++17 filesystem
	select BR2_PACKAGE_LIBARCHIVE
	select BR2_PACKAGE_OPENSSL
	select BR2_PACKAGE_JSON_FOR_MODERN_CPP
	select BR2_PACKAGE_YAML_CPP
	select BR2_PACKAGE_SPDLOG
	select BR2_PACKAGE_LIBCURL
	select BR2_PACKAGE_LIBSOLV
	select BR2_PACKAGE_REPROC
	select BR2_PACKAGE_TL_EXPECTED
	select BR2_PACKAGE_CLI11
	select BR2_PACKAGE_FMT
	select BR2_PACKAGE_TERMCOLOR
	help
	  micromamba is a small, pure-C++ reimplementation of
	  mamba/conda. It strives to be a full replacement for mamba and
	  conda.

	  https://github.com/mamba-org/mamba

comment "micromamba needs a toolchain w/ wchar, threads, C++, gcc >= 8"
	depends on BR2_PACKAGE_MICROMAMBA_ARCH_SUPPORTS
	depends on !BR2_USE_WCHAR || !BR2_INSTALL_LIBSTDCPP || \
		!BR2_TOOLCHAIN_HAS_THREADS || \
		!BR2_TOOLCHAIN_GCC_AT_LEAST_8
```

## package/open-iscsi/Config.in
```kconfig
config BR2_PACKAGE_OPEN_ISCSI
	bool "open-iscsi"
	depends on BR2_USE_MMU # fork()
	depends on BR2_TOOLCHAIN_HAS_THREADS # pthread
	depends on !BR2_STATIC_LIBS # kmod
	select BR2_PACKAGE_OPENSSL
	select BR2_PACKAGE_OPEN_ISCSI_ISCSISTART \
		if !BR2_PACKAGE_OPEN_ISCSI_ISCSID
	select BR2_PACKAGE_KMOD
	select BR2_PACKAGE_UTIL_LINUX
	select BR2_PACKAGE_UTIL_LINUX_LIBS
	select BR2_PACKAGE_UTIL_LINUX_LIBMOUNT
	help
	  iSCSI tools for Linux.

	  https://www.open-iscsi.com

if BR2_PACKAGE_OPEN_ISCSI

config BR2_PACKAGE_OPEN_ISCSI_ISCSID
	bool "iscsid"
	default y
	select BR2_PACKAGE_OPEN_ISNS
	help
	  iscsid implements the control path of iSCSI protocol, plus
	  some management facilities.

config BR2_PACKAGE_OPEN_ISCSI_ISCSISTART
	bool "iscsistart"
	help
	  iscsistart is used for attaching to iSCSI targets during
	  bootup.

endif

comment "open-iscsi needs a toolchain w/ threads, dynamic library"
	depends on BR2_USE_MMU
	depends on !BR2_TOOLCHAIN_HAS_THREADS || BR2_STATIC_LIBS
```

## package/open-isns/Config.in
```kconfig
config BR2_PACKAGE_OPEN_ISNS
	bool "open-isns (libisns)"
	depends on BR2_USE_MMU # fork()
	help
	  iSNS server and client for Linux.

	  Note that this option only installs the libraries, and not the
	  programs.

	  https://github.com/open-iscsi/open-isns

if BR2_PACKAGE_OPEN_ISNS

config BR2_PACKAGE_OPEN_ISNS_PROGS
	bool "open-isns programs"
	help
	  This option tells open-isns to not only install the libraries,
	  but also the programs.

endif
```
